## CMakeLists.txt
```
# QPC Zephyr example
# SPDX-License-Identifier: GPL-3.0-or-later OR LicenseRef-QL-commercial

cmake_minimum_required(VERSION 3.20.0)
find_package(Zephyr REQUIRED HINTS $ENV{ZEPHYR_BASE})

project(real-time)

target_sources(app PRIVATE
 src/main.c
 src/bsp.c
 src/periodic1.c
 src/periodic4.c
 src/sporadic2.c
 src/sporadic3.c
)

# QPC framework directory
# NOTE:
# Adjust this path for a different relative path
# between your project and the QPC folder
#
set(QPC_DIR ../../..)

# option to turn QSPY software tracing ON or OFF (file prj.conf)
# NOTE:
# change of the option might require re-building the project
#
option(QSPY "QSPY software tracing" OFF)

# QPC framework includes and sources...
zephyr_include_directories(
 ${QPC_DIR}/include
 ${QPC_DIR}/zephyr
 ./src
)
target_sources(app PRIVATE
 ${QPC_DIR}/src/qf/qep_hsm.c
 ${QPC_DIR}/src/qf/qep_msm.c
 ${QPC_DIR}/src/qf/qf_act.c
 ${QPC_DIR}/src/qf/qf_qact.c
 ${QPC_DIR}/src/qf/qf_defer.c
 ${QPC_DIR}/src/qf/qf_dyn.c
 ${QPC_DIR}/src/qf/qf_mem.c
 ${QPC_DIR}/src/qf/qf_ps.c
 ${QPC_DIR}/src/qf/qf_qact.c
 ${QPC_DIR}/src/qf/qf_qeq.c
 ${QPC_DIR}/src/qf/qf_qmact.c
 ${QPC_DIR}/src/qf/qf_time.c
 ${QPC_DIR}/zephyr/qf_port.c
)

# application-level "idle thread"...
if(QIDLE)
add_compile_definitions(QF_IDLE)
endif()
```

## prj.conf
```kconfig
# QPC Zephyr application
# SPDX-License-Identifier: GPL-3.0-or-later OR LicenseRef-QL-commercial

CONFIG_SYS_CLOCK_TICKS_PER_SEC=5000

CONFIG_THREAD_NAME=y
CONFIG_REBOOT=y

# reduce the Zephyr RAM footprint, see:
# https://docs.zephyrproject.org/latest/develop/optimizations/footprint.html
CONFIG_ISR_STACK_SIZE=1024
CONFIG_MAIN_STACK_SIZE=512
CONFIG_SYSTEM_WORKQUEUE_STACK_SIZE=512
CONFIG_PRIVILEGED_STACK_SIZE=512
```

## src/main.c
```c
//============================================================================
// APP example
// Last updated for version 7.3.0
// Last updated on  2023-08-09
//
//                   Q u a n t u m  L e a P s
//                   ------------------------
//                   Modern Embedded Software
//
// Copyright (C) 2005 Quantum Leaps, LLC. <www.state-machine.com>
//
// This program is open source software: you can redistribute it and/or
// modify it under the terms of the GNU General Public License as published
// by the Free Software Foundation, either version 3 of the License, or
// (at your option) any later version.
//
// Alternatively, this program may be distributed and modified under the
// terms of Quantum Leaps commercial licenses, which expressly supersede
// the GNU General Public License and are specifically designed for
// licensees interested in retaining the proprietary status of their code.
//
// This program is distributed in the hope that it will be useful,
// but WITHOUT ANY WARRANTY; without even the implied warranty of
// MERCHANTABILITY or FITNESS FOR A PARTICULAR PURPOSE. See the
// GNU General Public License for more details.
//
// You should have received a copy of the GNU General Public License
// along with this program. If not, see <www.gnu.org/licenses/>.
//
// Contact information:
// <www.state-machine.com/licensing>
// <info@state-machine.com>
//============================================================================
#include "qpc.h"     // QP/C real-time event framework
#include "app.h"     // Application interface
#include "bsp.h"     // Board Support Package

//............................................................................
int main() {
    QF_init();       // initialize the framework and the underlying RT kernel
    BSP_init();      // initialize the BSP
    BSP_start();     // start the AOs/Threads
    return QF_run(); // run the QF application
}
```

## src/app.h
```c
//$file${.::app.h} vvvvvvvvvvvvvvvvvvvvvvvvvvvvvvvvvvvvvvvvvvvvvvvvvvvvvvvvvvv
//
// Model: real-time.qm
// File:  ${.::app.h}
//
// This code has been generated by QM 7.0.2 <www.state-machine.com/qm>.
// DO NOT EDIT THIS FILE MANUALLY. All your changes will be lost.
//
// Copyright (c) 2005 Quantum Leaps, LLC. All rights reserved.
//
//                 ____________________________________
//                /                                   /
//               /    GGGGGGG    PPPPPPPP   LL       /
//              /   GG     GG   PP     PP  LL       /
//             /   GG          PP     PP  LL       /
//            /   GG   GGGGG  PPPPPPPP   LL       /
//           /   GG      GG  PP         LL       /
//          /     GGGGGGG   PP         LLLLLLL  /
//         /___________________________________/
//
// SPDX-License-Identifier: GPL-3.0-or-later
//
// This generated code is open-source software licensed under the GNU
// General Public License (GPL) as published by the Free Software Foundation
// (see <https://www.gnu.org/licenses>).
//
// NOTE:
// The GPL does NOT permit the incorporation of this code into proprietary
// programs. Please contact Quantum Leaps for commercial licensing options,
// which expressly supersede the GPL and are designed explicitly for
// closed-source distribution.
//
// Quantum Leaps contact information:
// <www.state-machine.com/licensing>
// <info@state-machine.com>
//
//$endhead${.::app.h} ^^^^^^^^^^^^^^^^^^^^^^^^^^^^^^^^^^^^^^^^^^^^^^^^^^^^^^^^
#ifndef APP_H_
#define APP_H_

//$declare${Shared} vvvvvvvvvvvvvvvvvvvvvvvvvvvvvvvvvvvvvvvvvvvvvvvvvvvvvvvvvv

//${Shared::AppSignals} ......................................................
enum AppSignals {
    PERIODIC_SPEC_SIG = Q_USER_SIG,
    TIMEOUT_SIG,
    SPORADIC_A_SIG,
    SPORADIC_B_SIG,
    REMINDER_SIG,
    // ...
    MAX_SIG  // the last signal
};

//${Shared::PeriodicSpecEvt} .................................................
typedef struct {
// protected:
    QEvt super;

// public:
    uint16_t toggles;
    uint8_t ticks;
} PeriodicSpecEvt;

//${Shared::SporadicSpecEvt} .................................................
typedef struct {
// protected:
    QEvt super;

// public:
    uint16_t toggles;
    uint16_t rtc_toggles;
} SporadicSpecEvt;

//${Shared::AO_Periodic1} ....................................................
extern QActive * const AO_Periodic1;

//${Shared::Periodic1_ctor} ..................................................
void Periodic1_ctor(void);

//${Shared::AO_Periodic4} ....................................................
extern QActive * const AO_Periodic4;

//${Shared::Periodic4_ctor} ..................................................
void Periodic4_ctor(void);

//${Shared::AO_Sporadic2} ....................................................
extern QActive * const AO_Sporadic2;

//${Shared::Sporadic2_ctor} ..................................................
void Sporadic2_ctor(void);

//${Shared::AO_Sporadic3} ....................................................
extern QActive * const AO_Sporadic3;

//${Shared::Sporadic3_ctor} ..................................................
void Sporadic3_ctor(void);
//$enddecl${Shared} ^^^^^^^^^^^^^^^^^^^^^^^^^^^^^^^^^^^^^^^^^^^^^^^^^^^^^^^^^^

#endif // APP_H_
```

## src/bsp.c
```c
//============================================================================
// BSP for "real-time" Example, NUCLEO-C031C6 board, Zephyr RTOS
//
// Copyright (C) 2005 Quantum Leaps, LLC. All rights reserved.
//
//                    Q u a n t u m  L e a P s
//                    ------------------------
//                    Modern Embedded Software
//
// SPDX-License-Identifier: GPL-3.0-or-later OR LicenseRef-QL-commercial
//
// This software is dual-licensed under the terms of the open-source GNU
// General Public License (GPL) or under the terms of one of the closed-
// source Quantum Leaps commercial licenses.
//
// Redistributions in source code must retain this top-level comment block.
// Plagiarizing this software to sidestep the license obligations is illegal.
//
// NOTE:
// The GPL does NOT permit the incorporation of this code into proprietary
// programs. Please contact Quantum Leaps for commercial licensing options,
// which expressly supersede the GPL and are designed explicitly for
// closed-source distribution.
//
// Quantum Leaps contact information:
// <www.state-machine.com/licensing>
// <info@state-machine.com>
//============================================================================
#include "qpc.h"                 // QP/C real-time event framework
#include "bsp.h"                 // Board Support Package
#include "app.h"                 // Application interface

#include <zephyr/drivers/gpio.h>
#include <zephyr/sys/reboot.h>
// add other drivers if necessary...

#ifdef Q_SPY
    #error QP/Spy software tracing not available in this application
#endif

Q_DEFINE_THIS_FILE  // define the name of this file for assertions

// Local-scope objects -----------------------------------------------------

// test pins on GPIO PA (output)
#define TST1_PIN  7U
#define TST2_PIN  6U
#define TST3_PIN  4U
#define TST4_PIN  1U
#define TST5_PIN  0U
#define TST6_PIN  9U
#define TST7_PIN  5U // LED LD2-Green

// Button pins available on the board (just one user Button B1 on PC.13)
// button on GPIO PC (input)
#define B1_PIN    13U

//============================================================================
// Error handler

Q_NORETURN Q_onError(char const * const module, int_t const id) {
    // NOTE: this implementation of the error handler is intended only
    // for debugging and MUST be changed for deployment of the application
    // (assuming that you ship your production code with assertions enabled).
    Q_UNUSED_PAR(module);
    Q_UNUSED_PAR(id);
    QS_ASSERTION(module, id, 10000U); // report assertion to QS
    Q_PRINTK("\nERROR in %s:%d\n", module, id);

#ifndef NDEBUG
    k_panic(); // debug build: halt the system for error search...
#endif

    sys_reboot(SYS_REBOOT_COLD); // release build: reboot the system
    for (;;) { // explicitly "no-return"
    }
}
//............................................................................
// assertion failure handler for the STM32 library, including the startup code
void assert_failed(char const * const module, int_t const id); // prototype
void assert_failed(char const * const module, int_t const id) {
    Q_onError(module, id);
}

//............................................................................
static void custom_tick_callback(struct k_timer *tid); // prototype
static void custom_tick_callback(struct k_timer *tid) {
    Q_UNUSED_PAR(tid);

    BSP_d1on();

    QTIMEEVT_TICK_X(0U, (void *)0);

    // Perform the debouncing of buttons. The algorithm for debouncing
    // adapted from the book "Embedded Systems Dictionary" by Jack Ganssle
    // and Michael Barr, page 71.
    static struct {
        uint32_t depressed;
        uint32_t previous;
    } buttons = { 0U, 0U };

    uint32_t current = ~GPIOC->IDR; // read Port C with state of Button B1
    uint32_t tmp = buttons.depressed; // save the depressed buttons
    buttons.depressed |= (buttons.previous & current); // set depressed
    buttons.depressed &= (buttons.previous | current); // clear released
    buttons.previous   = current; // update the history
    tmp ^= buttons.depressed;     // changed debounced depressed
    current = buttons.depressed;

    if ((tmp & (1U << B1_PIN)) != 0U) { // debounced B1 state changed?
        if ((current & (1U << B1_PIN)) != 0U) { // is B1 depressed?
            // immutable sporadic-press event
            static SporadicSpecEvt const sporadicA = {
                QEVT_INITIALIZER(SPORADIC_A_SIG),
                .toggles = 189U,
            };
            // immutable forward-press event
            static SporadicSpecEvt const sporadicB = {
                QEVT_INITIALIZER(SPORADIC_B_SIG),
                .toggles = 89U,
            };
            QACTIVE_POST(AO_Sporadic2, &sporadicA.super, (void *)0);
            QACTIVE_POST(AO_Sporadic2, &sporadicB.super, (void *)0);
        }
        else { // B1 is released
            QACTIVE_POST(AO_Periodic4, BSP_getEvtPeriodic4(0U), (void *)0);
            QACTIVE_POST(AO_Periodic1, BSP_getEvtPeriodic1(0U), (void *)0);
        }
    }

    BSP_d1off();
}

// BSP functions =============================================================
void BSP_init(void) {
    // NOTE: the CPU clock is configured in Zephyr (48MHz)

    // Configure the MPU to prevent NULL-pointer dereferencing ...
    MPU->RBAR = 0x0U                          // base address (NULL)
                | MPU_RBAR_VALID_Msk          // valid region
                | (MPU_RBAR_REGION_Msk & 7U); // region #7
    MPU->RASR = (7U << MPU_RASR_SIZE_Pos)     // 2^(7+1) region
                | (0x0U << MPU_RASR_AP_Pos)   // no-access region
                | MPU_RASR_ENABLE_Msk;        // region enable
    MPU->CTRL = MPU_CTRL_PRIVDEFENA_Msk       // enable background region
                | MPU_CTRL_ENABLE_Msk;        // enable the MPU
    __ISB();
    __DSB();

    // enable GPIO port PA clock
    RCC->IOPENR |= (1U << 0U);

    // set all used GPIOA pins as push-pull output, no pull-up, pull-down
    GPIOA->MODER &=
        ~((3U << 2U*TST1_PIN) | (3U << 2U*TST2_PIN) | (3U << 2U*TST3_PIN) |
          (3U << 2U*TST4_PIN) | (3U << 2U*TST5_PIN) | (3U << 2U*TST6_PIN) |
          (3U << 2U*TST7_PIN));
    GPIOA->MODER |=
         ((1U << 2U*TST1_PIN) | (1U << 2U*TST2_PIN) | (1U << 2U*TST3_PIN) |
          (1U << 2U*TST4_PIN) | (1U << 2U*TST5_PIN) | (1U << 2U*TST6_PIN) |
          (1U << 2U*TST7_PIN));
    GPIOA->OTYPER &=
        ~((1U <<    TST1_PIN) | (1U <<    TST2_PIN) | (1U <<    TST3_PIN) |
          (1U <<    TST4_PIN) | (1U <<    TST5_PIN) | (1U <<    TST6_PIN) |
          (1U <<    TST7_PIN));
    GPIOA->PUPDR &=
        ~((3U << 2U*TST1_PIN) | (3U << 2U*TST2_PIN) | (3U << 2U*TST3_PIN) |
          (3U << 2U*TST4_PIN) | (3U << 2U*TST5_PIN) | (3U << 2U*TST6_PIN) |
          (3U << 2U*TST7_PIN));

    // enable GPIOC clock port for the Button B1
    RCC->IOPENR |=  (1U << 2U);

    // configure Button B1 pin on GPIOC as input, no pull-up, pull-down
    GPIOC->MODER &= ~(3U << 2U*B1_PIN);
    GPIOC->PUPDR &= ~(3U << 2U*B1_PIN);
}
//............................................................................
void BSP_start(void) {
    // instantiate and start QP/C active objects...
    Periodic1_ctor();
    static QEvtPtr periodic1QSto[10]; // Event queue storage
    static K_THREAD_STACK_DEFINE(periodic1Stack, 512);
    QActive_start(
        AO_Periodic1,          // AO pointer to start
        Q_PRIO(1U, 4U),        // QF-prio/Zephyr-prio
        periodic1QSto,         // storage for the AO's queue
        Q_DIM(periodic1QSto),  // queue length
        periodic1Stack,        // stack storage (needed for FreeRTOS)
        K_THREAD_STACK_SIZEOF(periodic1Stack), // stack size [Zephyr]
        BSP_getEvtPeriodic1(0U)); // initialization param

    Sporadic2_ctor();
    static QEvtPtr sporadic2QSto[8]; // Event queue storage
    static K_THREAD_STACK_DEFINE(sporadic2Stack, 512);
    QActive_start(
        AO_Sporadic2,          // AO pointer to start
        Q_PRIO(2U, 3U),        // QF-prio/Zephyr-prio
        sporadic2QSto,         // storage for the AO's queue
        Q_DIM(sporadic2QSto),  // queue length
        sporadic2Stack,        // stack storage (needed for FreeRTOS)
        K_THREAD_STACK_SIZEOF(sporadic2Stack), // stack size [Zephyr]
        (void const *)0);      // initialization param -- not used

    Sporadic3_ctor();
    static QEvtPtr sporadic3QSto[8]; // Event queue storage
    static K_THREAD_STACK_DEFINE(sporadic3Stack, 512);
    QActive_start(
        AO_Sporadic3,          // AO pointer to start
        Q_PRIO(3U, 2U),        // QF-prio/Zephyr-prio
        sporadic3QSto,         // storage for the AO's queue
        Q_DIM(sporadic3QSto),  // queue length
        sporadic3Stack,        // stack storage (needed for FreeRTOS)
        K_THREAD_STACK_SIZEOF(sporadic3Stack), // stack size [Zephyr]
        (void const *)0);      // initialization param -- not used

    Periodic4_ctor();
    static QEvtPtr periodic4QSto[8]; // Event queue storage
    static K_THREAD_STACK_DEFINE(periodic4Stack, 512);
    QActive_start(
        AO_Periodic4,          // AO pointer to start
        Q_PRIO(4U, 1U),        // QF-prio/Zephyr-prio
        periodic4QSto,         // storage for the AO's queue
        Q_DIM(periodic4QSto),  // queue length
        periodic4Stack,        // stack storage (needed for FreeRTOS)
        K_THREAD_STACK_SIZEOF(periodic4Stack), // stack size [Zephyr]
        BSP_getEvtPeriodic4(0U)); // initialization event
}
//............................................................................
void BSP_d1on(void)  { GPIOA->BSRR = (1U << TST1_PIN); __NOP(); __NOP(); }
void BSP_d1off(void) { GPIOA->BSRR = (1U << (TST1_PIN + 16U)); __NOP(); __NOP(); }
//............................................................................
void BSP_d2on(void)  { GPIOA->BSRR = (1U << TST2_PIN); __NOP(); __NOP(); }
void BSP_d2off(void) { GPIOA->BSRR = (1U << (TST2_PIN + 16U)); __NOP(); __NOP(); }
//............................................................................
void BSP_d3on(void)  { GPIOA->BSRR = (1U << TST3_PIN); __NOP(); __NOP(); }
void BSP_d3off(void) { GPIOA->BSRR = (1U << (TST3_PIN + 16U)); __NOP(); __NOP(); }
//............................................................................
void BSP_d4on(void)  { GPIOA->BSRR = (1U << TST4_PIN); __NOP(); __NOP(); }
void BSP_d4off(void) { GPIOA->BSRR = (1U << (TST4_PIN + 16U)); __NOP(); __NOP(); }
//............................................................................
void BSP_d5on(void)  { GPIOA->BSRR = (1U << TST5_PIN); __NOP(); __NOP(); }
void BSP_d5off(void) { GPIOA->BSRR = (1U << (TST5_PIN + 16U)); __NOP(); __NOP(); }
//............................................................................
void BSP_d6on(void)  { GPIOA->BSRR = (1U << TST6_PIN); __NOP(); __NOP(); }
void BSP_d6off(void) { GPIOA->BSRR = (1U << (TST6_PIN + 16U)); __NOP(); __NOP(); }
//............................................................................
void BSP_d7on(void)  { GPIOA->BSRR = (1U << TST7_PIN); __NOP(); __NOP(); }
void BSP_d7off(void) { GPIOA->BSRR = (1U << (TST7_PIN + 16U)); __NOP(); __NOP(); }

//............................................................................
QEvt const *BSP_getEvtPeriodic1(uint8_t num) {
    // immutable PERIODIC_SPEC events for Periodic1
    static PeriodicSpecEvt const periodicSpec1[] = {
        {
            QEVT_INITIALIZER(PERIODIC_SPEC_SIG),
            .toggles = 40U,
            .ticks = 5U,
        },
        {
            QEVT_INITIALIZER(PERIODIC_SPEC_SIG),
            .toggles = 30U,
            .ticks = 7U,
        }
    };
    Q_REQUIRE_ID(500, num < Q_DIM(periodicSpec1)); // must be in range
    return &periodicSpec1[num].super;
}
//............................................................................
QEvt const *BSP_getEvtPeriodic4(uint8_t num) {
    // immutable PERIODIC_SPEC events for Periodic4
    static PeriodicSpecEvt const periodicSpec4[] = {
        {
            QEVT_INITIALIZER(PERIODIC_SPEC_SIG),
            .toggles = 20U,
            .ticks = 2U,
        },
        {
            QEVT_INITIALIZER(PERIODIC_SPEC_SIG),
            .toggles = 10U,
            .ticks = 1U,
        },
    };
    Q_REQUIRE_ID(600, num < Q_DIM(periodicSpec4)); // must be in range
    return &periodicSpec4[num].super;
}

// QF callbacks ==============================================================
void QF_onStartup(void) {
    static struct k_timer zephyr_tick_timer;
    k_timer_init(&zephyr_tick_timer, &custom_tick_callback, NULL);
    k_timer_start(&zephyr_tick_timer, K_TICKS(1), K_TICKS(1));
}
//............................................................................
void QF_onCleanup(void) {
}
//............................................................................
#ifdef QF_IDLE
void QF_onIdle(void) {
    BSP_d7on();
    BSP_d7off();
}
#endif
```

## src/bsp.h
```c
//============================================================================
// "real-time" example to demonstrate timing in QP/C
//
// Copyright (C) 2005 Quantum Leaps, LLC. All rights reserved.
//
//                   Q u a n t u m  L e a P s
//                   ------------------------
//                   Modern Embedded Software
//
// SPDX-License-Identifier: GPL-3.0-or-later OR LicenseRef-QL-commercial
//
// This software is dual-licensed under the terms of the open source GNU
// General Public License version 3 (or any later version), or alternatively,
// under the terms of one of the closed source Quantum Leaps commercial
// licenses.
//
// The terms of the open source GNU General Public License version 3
// can be found at: <www.gnu.org/licenses/gpl-3.0>
//
// The terms of the closed source Quantum Leaps commercial licenses
// can be found at: <www.state-machine.com/licensing>
//
// Redistributions in source code must retain this top-level comment block.
// Plagiarizing this software to sidestep the license obligations is illegal.
//
// Contact information:
// <www.state-machine.com/licensing>
// <info@state-machine.com>
//============================================================================
#ifndef BSP_H_
#define BSP_H_

#define BSP_TICKS_PER_SEC    CONFIG_SYS_CLOCK_TICKS_PER_SEC

void BSP_init(void);
void BSP_start(void);

void BSP_d1on(void);
void BSP_d1off(void);

void BSP_d2on(void);
void BSP_d2off(void);

void BSP_d3on(void);
void BSP_d3off(void);

void BSP_d4on(void);
void BSP_d4off(void);

void BSP_d5on(void);
void BSP_d5off(void);

void BSP_d6on(void);
void BSP_d6off(void);

void BSP_d7on(void);
void BSP_d7off(void);

// immutable events for Periodic active objects
QEvt const *BSP_getEvtPeriodic1(uint8_t num);
QEvt const *BSP_getEvtPeriodic4(uint8_t num);

#endif // BSP_H_
```

## src/periodic1.c
```c
//$file${.::periodic1.c} vvvvvvvvvvvvvvvvvvvvvvvvvvvvvvvvvvvvvvvvvvvvvvvvvvvvv
//
// Model: real-time.qm
// File:  ${.::periodic1.c}
//
// This code has been generated by QM 7.0.2 <www.state-machine.com/qm>.
// DO NOT EDIT THIS FILE MANUALLY. All your changes will be lost.
//
// Copyright (c) 2005 Quantum Leaps, LLC. All rights reserved.
//
//                 ____________________________________
//                /                                   /
//               /    GGGGGGG    PPPPPPPP   LL       /
//              /   GG     GG   PP     PP  LL       /
//             /   GG          PP     PP  LL       /
//            /   GG   GGGGG  PPPPPPPP   LL       /
//           /   GG      GG  PP         LL       /
//          /     GGGGGGG   PP         LLLLLLL  /
//         /___________________________________/
//
// SPDX-License-Identifier: GPL-3.0-or-later
//
// This generated code is open-source software licensed under the GNU
// General Public License (GPL) as published by the Free Software Foundation
// (see <https://www.gnu.org/licenses>).
//
// NOTE:
// The GPL does NOT permit the incorporation of this code into proprietary
// programs. Please contact Quantum Leaps for commercial licensing options,
// which expressly supersede the GPL and are designed explicitly for
// closed-source distribution.
//
// Quantum Leaps contact information:
// <www.state-machine.com/licensing>
// <info@state-machine.com>
//
//$endhead${.::periodic1.c} ^^^^^^^^^^^^^^^^^^^^^^^^^^^^^^^^^^^^^^^^^^^^^^^^^^
#include "qpc.h"               // QP/C real-time event framework
#include "bsp.h"               // Board Support Package
#include "app.h"               // Application interface

//$declare${AOs::Periodic1} vvvvvvvvvvvvvvvvvvvvvvvvvvvvvvvvvvvvvvvvvvvvvvvvvv

//${AOs::Periodic1} ..........................................................
typedef struct Periodic1 {
// protected:
    QMActive super;

// public:
    QTimeEvt te;
    uint16_t toggles;
} Periodic1;

extern Periodic1 Periodic1_inst;

// protected:
static QState Periodic1_initial(Periodic1 * const me, void const * const par);
static QState Periodic1_active  (Periodic1 * const me, QEvt const * const e);
static QMState const Periodic1_active_s = {
    QM_STATE_NULL, // superstate (top)
    Q_STATE_CAST(&Periodic1_active),
    Q_ACTION_NULL, // no entry action
    Q_ACTION_NULL, // no exit action
    Q_ACTION_NULL  // no initial tran.
};
//$enddecl${AOs::Periodic1} ^^^^^^^^^^^^^^^^^^^^^^^^^^^^^^^^^^^^^^^^^^^^^^^^^^

Q_DEFINE_THIS_MODULE("periodic1")

//$skip${QP_VERSION} vvvvvvvvvvvvvvvvvvvvvvvvvvvvvvvvvvvvvvvvvvvvvvvvvvvvvvvvv
// Check for the minimum required QP version
#if (QP_VERSION < 730U) || (QP_VERSION != ((QP_RELEASE^4294967295U)%0x2710U))
#error qpc version 7.3.0 or higher required
#endif
//$endskip${QP_VERSION} ^^^^^^^^^^^^^^^^^^^^^^^^^^^^^^^^^^^^^^^^^^^^^^^^^^^^^^
//$define${Shared::Periodic1_ctor} vvvvvvvvvvvvvvvvvvvvvvvvvvvvvvvvvvvvvvvvvvv

//${Shared::Periodic1_ctor} ..................................................
void Periodic1_ctor(void) {
    Periodic1 * const me = &Periodic1_inst;
    QMActive_ctor(&me->super, Q_STATE_CAST(&Periodic1_initial));
    QTimeEvt_ctorX(&me->te, (QActive *)me, TIMEOUT_SIG, 0U);
}
//$enddef${Shared::Periodic1_ctor} ^^^^^^^^^^^^^^^^^^^^^^^^^^^^^^^^^^^^^^^^^^^
//$define${Shared::AO_Periodic1} vvvvvvvvvvvvvvvvvvvvvvvvvvvvvvvvvvvvvvvvvvvvv

//${Shared::AO_Periodic1} ....................................................
QActive * const AO_Periodic1 = (QActive *)&Periodic1_inst;
//$enddef${Shared::AO_Periodic1} ^^^^^^^^^^^^^^^^^^^^^^^^^^^^^^^^^^^^^^^^^^^^^
//$define${AOs::Periodic1} vvvvvvvvvvvvvvvvvvvvvvvvvvvvvvvvvvvvvvvvvvvvvvvvvvv

//${AOs::Periodic1} ..........................................................
Periodic1 Periodic1_inst;

//${AOs::Periodic1::SM} ......................................................
static QState Periodic1_initial(Periodic1 * const me, void const * const par) {
    //${AOs::Periodic1::SM::initial}
    // the initial event must be provided and must be WORKLOAD_SIG
    QEvt const *e =  (QEvt const *)par;

    Q_REQUIRE_ID(300, (e != (QEvt const *)0)
                 && (e->sig == PERIODIC_SPEC_SIG));

    QTimeEvt_armX(&me->te,
        Q_EVT_CAST(PeriodicSpecEvt)->ticks,
        Q_EVT_CAST(PeriodicSpecEvt)->ticks);
    me->toggles = Q_EVT_CAST(PeriodicSpecEvt)->toggles;

    QS_FUN_DICTIONARY(&Periodic1_active);

    static QMTranActTable const tatbl_ = { // tran-action table
        &Periodic1_active_s, // target state
        {
            Q_ACTION_NULL // zero terminator
        }
    };
    return QM_TRAN_INIT(&tatbl_);
}

//${AOs::Periodic1::SM::active} ..............................................
//${AOs::Periodic1::SM::active}
static QState Periodic1_active(Periodic1 * const me, QEvt const * const e) {
    QState status_;
    switch (e->sig) {
        //${AOs::Periodic1::SM::active::TIMEOUT}
        case TIMEOUT_SIG: {
            for (uint16_t i = me->toggles; i > 0U; --i) {
                BSP_d6on();
                BSP_d6off();
            }
            status_ = QM_HANDLED();
            break;
        }
        //${AOs::Periodic1::SM::active::PERIODIC_SPEC}
        case PERIODIC_SPEC_SIG: {
            BSP_d6on();
            QTimeEvt_disarm(&me->te);
            QTimeEvt_armX(&me->te,
                Q_EVT_CAST(PeriodicSpecEvt)->ticks,
                Q_EVT_CAST(PeriodicSpecEvt)->ticks);
            me->toggles = Q_EVT_CAST(PeriodicSpecEvt)->toggles;
            BSP_d6off();
            status_ = QM_HANDLED();
            break;
        }
        default: {
            status_ = QM_SUPER();
            break;
        }
    }
    return status_;
}
//$enddef${AOs::Periodic1} ^^^^^^^^^^^^^^^^^^^^^^^^^^^^^^^^^^^^^^^^^^^^^^^^^^^
```

## src/periodic4.c
```c
//$file${.::periodic4.c} vvvvvvvvvvvvvvvvvvvvvvvvvvvvvvvvvvvvvvvvvvvvvvvvvvvvv
//
// Model: real-time.qm
// File:  ${.::periodic4.c}
//
// This code has been generated by QM 7.0.2 <www.state-machine.com/qm>.
// DO NOT EDIT THIS FILE MANUALLY. All your changes will be lost.
//
// Copyright (c) 2005 Quantum Leaps, LLC. All rights reserved.
//
//                 ____________________________________
//                /                                   /
//               /    GGGGGGG    PPPPPPPP   LL       /
//              /   GG     GG   PP     PP  LL       /
//             /   GG          PP     PP  LL       /
//            /   GG   GGGGG  PPPPPPPP   LL       /
//           /   GG      GG  PP         LL       /
//          /     GGGGGGG   PP         LLLLLLL  /
//         /___________________________________/
//
// SPDX-License-Identifier: GPL-3.0-or-later
//
// This generated code is open-source software licensed under the GNU
// General Public License (GPL) as published by the Free Software Foundation
// (see <https://www.gnu.org/licenses>).
//
// NOTE:
// The GPL does NOT permit the incorporation of this code into proprietary
// programs. Please contact Quantum Leaps for commercial licensing options,
// which expressly supersede the GPL and are designed explicitly for
// closed-source distribution.
//
// Quantum Leaps contact information:
// <www.state-machine.com/licensing>
// <info@state-machine.com>
//
//$endhead${.::periodic4.c} ^^^^^^^^^^^^^^^^^^^^^^^^^^^^^^^^^^^^^^^^^^^^^^^^^^
#include "qpc.h"               // QP/C real-time event framework
#include "bsp.h"               // Board Support Package
#include "app.h"               // Application interface

//$declare${AOs::Periodic4} vvvvvvvvvvvvvvvvvvvvvvvvvvvvvvvvvvvvvvvvvvvvvvvvvv

//${AOs::Periodic4} ..........................................................
typedef struct Periodic4 {
// protected:
    QMActive super;

// public:
    QTimeEvt te;
    uint16_t toggles;
} Periodic4;

extern Periodic4 Periodic4_inst;

// protected:
static QState Periodic4_initial(Periodic4 * const me, void const * const par);
static QState Periodic4_active  (Periodic4 * const me, QEvt const * const e);
static QMState const Periodic4_active_s = {
    QM_STATE_NULL, // superstate (top)
    Q_STATE_CAST(&Periodic4_active),
    Q_ACTION_NULL, // no entry action
    Q_ACTION_NULL, // no exit action
    Q_ACTION_NULL  // no initial tran.
};
//$enddecl${AOs::Periodic4} ^^^^^^^^^^^^^^^^^^^^^^^^^^^^^^^^^^^^^^^^^^^^^^^^^^

Q_DEFINE_THIS_MODULE("periodic4")

//$skip${QP_VERSION} vvvvvvvvvvvvvvvvvvvvvvvvvvvvvvvvvvvvvvvvvvvvvvvvvvvvvvvvv
// Check for the minimum required QP version
#if (QP_VERSION < 730U) || (QP_VERSION != ((QP_RELEASE^4294967295U)%0x2710U))
#error qpc version 7.3.0 or higher required
#endif
//$endskip${QP_VERSION} ^^^^^^^^^^^^^^^^^^^^^^^^^^^^^^^^^^^^^^^^^^^^^^^^^^^^^^
//$define${Shared::Periodic4_ctor} vvvvvvvvvvvvvvvvvvvvvvvvvvvvvvvvvvvvvvvvvvv

//${Shared::Periodic4_ctor} ..................................................
void Periodic4_ctor(void) {
    Periodic4 * const me = &Periodic4_inst;
    QMActive_ctor(&me->super, Q_STATE_CAST(&Periodic4_initial));
    QTimeEvt_ctorX(&me->te, (QActive *)me, TIMEOUT_SIG, 0U);
}
//$enddef${Shared::Periodic4_ctor} ^^^^^^^^^^^^^^^^^^^^^^^^^^^^^^^^^^^^^^^^^^^
//$define${Shared::AO_Periodic4} vvvvvvvvvvvvvvvvvvvvvvvvvvvvvvvvvvvvvvvvvvvvv

//${Shared::AO_Periodic4} ....................................................
QActive * const AO_Periodic4 = (QActive *)&Periodic4_inst;
//$enddef${Shared::AO_Periodic4} ^^^^^^^^^^^^^^^^^^^^^^^^^^^^^^^^^^^^^^^^^^^^^
//$define${AOs::Periodic4} vvvvvvvvvvvvvvvvvvvvvvvvvvvvvvvvvvvvvvvvvvvvvvvvvvv

//${AOs::Periodic4} ..........................................................
Periodic4 Periodic4_inst;

//${AOs::Periodic4::SM} ......................................................
static QState Periodic4_initial(Periodic4 * const me, void const * const par) {
    //${AOs::Periodic4::SM::initial}
    // the initial event must be provided and must be WORKLOAD_SIG
    QEvt const *e =  (QEvt const *)par;

    Q_REQUIRE_ID(300, (e != (QEvt const *)0)
                 && (e->sig == PERIODIC_SPEC_SIG));

    QTimeEvt_armX(&me->te,
        Q_EVT_CAST(PeriodicSpecEvt)->ticks,
        Q_EVT_CAST(PeriodicSpecEvt)->ticks);
    me->toggles = Q_EVT_CAST(PeriodicSpecEvt)->toggles;

    QS_FUN_DICTIONARY(&Periodic4_active);

    static QMTranActTable const tatbl_ = { // tran-action table
        &Periodic4_active_s, // target state
        {
            Q_ACTION_NULL // zero terminator
        }
    };
    return QM_TRAN_INIT(&tatbl_);
}

//${AOs::Periodic4::SM::active} ..............................................
//${AOs::Periodic4::SM::active}
static QState Periodic4_active(Periodic4 * const me, QEvt const * const e) {
    QState status_;
    switch (e->sig) {
        //${AOs::Periodic4::SM::active::TIMEOUT}
        case TIMEOUT_SIG: {
            for (uint16_t i = me->toggles; i > 0U; --i) {
                BSP_d3on();
                BSP_d3off();
            }
            status_ = QM_HANDLED();
            break;
        }
        //${AOs::Periodic4::SM::active::PERIODIC_SPEC}
        case PERIODIC_SPEC_SIG: {
            BSP_d3on();
            QTimeEvt_disarm(&me->te);
            QTimeEvt_armX(&me->te,
                Q_EVT_CAST(PeriodicSpecEvt)->ticks,
                Q_EVT_CAST(PeriodicSpecEvt)->ticks);
            me->toggles = Q_EVT_CAST(PeriodicSpecEvt)->toggles;
            BSP_d3off();
            status_ = QM_HANDLED();
            break;
        }
        default: {
            status_ = QM_SUPER();
            break;
        }
    }
    return status_;
}
//$enddef${AOs::Periodic4} ^^^^^^^^^^^^^^^^^^^^^^^^^^^^^^^^^^^^^^^^^^^^^^^^^^^
```

## src/qp_config.h
```c
//============================================================================
// QP configuration file example
//
// Copyright (C) 2005 Quantum Leaps, LLC. All rights reserved.
//
//                   Q u a n t u m  L e a P s
//                   ------------------------
//                   Modern Embedded Software
//
// SPDX-License-Identifier: GPL-3.0-or-later OR LicenseRef-QL-commercial
//
// This software is dual-licensed under the terms of the open-source GNU
// General Public License (GPL) or under the terms of one of the closed-
// source Quantum Leaps commercial licenses.
//
// Redistributions in source code must retain this top-level comment block.
// Plagiarizing this software to sidestep the license obligations is illegal.
//
// NOTE:
// The GPL (see <www.gnu.org/licenses/gpl-3.0>) does NOT permit the
// incorporation of the QP/C software into proprietary programs. Please
// contact Quantum Leaps for commercial licensing options, which expressly
// supersede the GPL and are designed explicitly for licensees interested
// in using QP/C in closed-source proprietary applications.
//
// Quantum Leaps contact information:
// <www.state-machine.com/licensing>
// <info@state-machine.com>
//============================================================================
#ifndef QP_CONFIG_H_
#define QP_CONFIG_H_

//-------- <<< Use Configuration Wizard in Context Menu >>> -----------------

// <o>QP API compatibility version (QP_API_VERSION)
//   <0=>  0   (Maximum compatibility)
//   <691=>691 (QP 6.9.1 or newer)
//   <734=>7.3.4 (QP 7.3.4 or newer)
//   <9999=>9999 (Latest only)
// <i>QP API backwards compatibility with the QP API version.
// <i>Lower QP_API_VERSION values enable backwards compatibility
// <i>with lower (older) QP API versions.
// <i>For example, QP_API_VERSION==691 will enable the compatibility
// <i>layer with QP version 6.9.1 and newer, but not older than 6.9.1.
// <i>QP_API_VERSION==0 enables the maximum currently supported
// <i>backwards compatibility. Conversely, QP_API_VERSION==9999 means
// <i>that no backwards compatibility layer should be enabled.
// <i>Default: 0 (All supported)
#define QP_API_VERSION 0

//..........................................................................
// <h>QP Functional Safety (FuSa) Subsystem (Q_UNSAFE)
// <i>The QP FuSa Subsystem consists of the following facilities:
// <i>- Software assertions as a recommended technique
// <i>  (called Failure Assertion Programming (FAP) in IEC 61508)
// <i>- Software Self-Monitoring (SSM), which encompasses such techniques:
// <i>  * Duplicate Inverse Storage for critical variables
// <i>  * Memory Markers for critical objects (e.g., events)
// <i>  * Hard-limits for all loops
// <i>  * Memory Isolation by means of Memory Protection Unit (MPU)

// <c3>Disable QP FuSa in development
// <i>Disable assertions and other self monitoring features
// <i>in development build configurations (NDEBUG undefined).
// <i>VIOLATES functional safety standards. NOT recommended !!!
//#ifndef NDEBUG
//#define Q_UNSAFE
//#endif
// </c>

// <c3>Disable QP FuSa in production release
// <i>Disable assertions and other self monitoring features
// <i>in the release build configurations (NDEBUG defined).
// <i>VIOLATES functional safety standards. NOT recommended !!!
//#ifdef NDEBUG
//#define Q_UNSAFE
//#endif
// </c>

// </h>

//..........................................................................
// <h>QF Framework
// <i>Active Object framework

// <o>Maximum # Active Objects (QF_MAX_ACTIVE) <1-64>
// <i>Maximum # Active Objects in the system <1..64>
// <i>Default: 32
#define QF_MAX_ACTIVE  CONFIG_NUM_PREEMPT_PRIORITIES

// <o>Maximum # event pools (QF_MAX_EPOOL)
// <0=>0 no event pools
// <1=>1 <2=>2 <3=>3 (default) <4=>4 <5=>5
// <6=>6 <7=>7 <8=>8 <9=>9 <10=>10 <11=>11
// <12=>12 <13=>13 <14=>14 <15=>15
// <i>Maximum # Event Pools <1..15>
// <i>Default: 3
#define QF_MAX_EPOOL 3U

// <o>Maximum # clock tick rates (QF_MAX_TICK_RATE)
// <0=>0 no time events
// <1=>1 (default) <2=>2 <3=>3 <4=>4 <5=>5
// <6=>6 <7=>7 <8=>8 <9=>9 <10=>10 <11=>11
// <12=>12 <13=>13 <14=>14 <15=>15
// <i>Maximum # clock tick rates for time events <1..15>
// <i>Default: 1
#define QF_MAX_TICK_RATE 1U

// <c1>Event parameter initialization (QEVT_PAR_INIT)
// <i>Resource Acquisition Is Initialization (RAII) for dynamic events
//#define QEVT_PAR_INIT
// </c>

// <c1>Active Object stop API (QACTIVE_CAN_STOP)
// <i>Enable Active Object stop API (Not recommended)
//#define QACTIVE_CAN_STOP
// </c>

// <o>Event size (QF_EVENT_SIZ_SIZE)
//   <1U=>1
//   <2U=>2 (default)
//   <4U=>4
// <i>Size of the dynamic events for QF [bytes]
// <i>Default: 2 (64K bytes maximum event size)
#define QF_EVENT_SIZ_SIZE   2U

// <o>Time event counter size (QF_TIMEEVT_CTR_SIZE)
//   <1U=>1
//   <2U=>2
//   <4U=>4 (default)
// <i>Size of the QTimeEvt counter [bytes]
// <i>Default: 4 (2^32 dynamic range)
#define QF_TIMEEVT_CTR_SIZE 4U

// <o>Event queue counter size (QF_EQUEUE_CTR_SIZE)
//   <1U=>1 (default)
//   <2U=>2
// <i>Size of event queue counter [bytes]
// <i>Default: 1 (255 events maximum in a queue)
#define QF_EQUEUE_CTR_SIZE  1U

// <o>Memory pool counter size (QF_MPOOL_CTR_SIZE)
//   <1U=>1
//   <2U=>2 (default)
//   <4U=>4
// <i>Size of memory pool counter [bytes]
// <i>Default: 2 (64K blocks maximum in a pool)
#define QF_MPOOL_CTR_SIZE 2U

// <o>Memory block size (QF_MPOOL_SIZ_SIZE)
//   <1U=>1
//   <2U=>2 (default)
//   <4U=>4
// <i>Size of memory pool block [bytes]
// <i>Default: 2 (64K bytes maximum block size)
#define QF_MPOOL_SIZ_SIZE 2U

// </h>

//..........................................................................
// <h>QS Software Tracing
// <i>Target-resident component of QP/Spy software tracing system
// <i>(tracing instrumentation and command-input).

// <n>NOTE: Requires command-line macro: Q_SPY
// <i>The QS software tracing instrumentation is activated only when
// <i>the macro Q_SPY is defined on the command-line to the compiler.
// <i>Typically, Q_SPY is defined only in the "spy" build configuration.

// <o>QS timestamp size (QS_TIME_SIZE)
//   <1U=>1
//   <2U=>2
//   <4U=>4 (default)
// <i>Size of the timestamp in QS [bytes]
// <i>Default: 4 (2^32 dynamic range)
#define QS_TIME_SIZE 4U

// <o>QS buffer counter size (QS_CTR_SIZE)
//   <1U=>1
//   <2U=>2 (default)
//   <4U=>4
// <i>Size of the counter in the internal QS buffer [bytes]
// <i>Default: 2 (64K bytes in QS buffer)
#define QS_CTR_SIZE 2U

// </h>

//------------- <<< end of configuration section >>> -----------------------

#endif // QP_CONFIG_H_
```

## src/sporadic2.c
```c
//$file${.::sporadic2.c} vvvvvvvvvvvvvvvvvvvvvvvvvvvvvvvvvvvvvvvvvvvvvvvvvvvvv
//
// Model: real-time.qm
// File:  ${.::sporadic2.c}
//
// This code has been generated by QM 7.0.2 <www.state-machine.com/qm>.
// DO NOT EDIT THIS FILE MANUALLY. All your changes will be lost.
//
// Copyright (c) 2005 Quantum Leaps, LLC. All rights reserved.
//
//                 ____________________________________
//                /                                   /
//               /    GGGGGGG    PPPPPPPP   LL       /
//              /   GG     GG   PP     PP  LL       /
//             /   GG          PP     PP  LL       /
//            /   GG   GGGGG  PPPPPPPP   LL       /
//           /   GG      GG  PP         LL       /
//          /     GGGGGGG   PP         LLLLLLL  /
//         /___________________________________/
//
// SPDX-License-Identifier: GPL-3.0-or-later
//
// This generated code is open-source software licensed under the GNU
// General Public License (GPL) as published by the Free Software Foundation
// (see <https://www.gnu.org/licenses>).
//
// NOTE:
// The GPL does NOT permit the incorporation of this code into proprietary
// programs. Please contact Quantum Leaps for commercial licensing options,
// which expressly supersede the GPL and are designed explicitly for
// closed-source distribution.
//
// Quantum Leaps contact information:
// <www.state-machine.com/licensing>
// <info@state-machine.com>
//
//$endhead${.::sporadic2.c} ^^^^^^^^^^^^^^^^^^^^^^^^^^^^^^^^^^^^^^^^^^^^^^^^^^
#include "qpc.h"               // QP/C real-time event framework
#include "bsp.h"               // Board Support Package
#include "app.h"               // Application interface

//$declare${AOs::Sporadic2} vvvvvvvvvvvvvvvvvvvvvvvvvvvvvvvvvvvvvvvvvvvvvvvvvv

//${AOs::Sporadic2} ..........................................................
typedef struct Sporadic2 {
// protected:
    QMActive super;

// public:
} Sporadic2;

extern Sporadic2 Sporadic2_inst;

// protected:
static QState Sporadic2_initial(Sporadic2 * const me, void const * const par);
static QState Sporadic2_active  (Sporadic2 * const me, QEvt const * const e);
static QMState const Sporadic2_active_s = {
    QM_STATE_NULL, // superstate (top)
    Q_STATE_CAST(&Sporadic2_active),
    Q_ACTION_NULL, // no entry action
    Q_ACTION_NULL, // no exit action
    Q_ACTION_NULL  // no initial tran.
};
//$enddecl${AOs::Sporadic2} ^^^^^^^^^^^^^^^^^^^^^^^^^^^^^^^^^^^^^^^^^^^^^^^^^^

//Q_DEFINE_THIS_MODULE("sporadic2")

//$skip${QP_VERSION} vvvvvvvvvvvvvvvvvvvvvvvvvvvvvvvvvvvvvvvvvvvvvvvvvvvvvvvvv
// Check for the minimum required QP version
#if (QP_VERSION < 730U) || (QP_VERSION != ((QP_RELEASE^4294967295U)%0x2710U))
#error qpc version 7.3.0 or higher required
#endif
//$endskip${QP_VERSION} ^^^^^^^^^^^^^^^^^^^^^^^^^^^^^^^^^^^^^^^^^^^^^^^^^^^^^^
//$define${Shared::Sporadic2_ctor} vvvvvvvvvvvvvvvvvvvvvvvvvvvvvvvvvvvvvvvvvvv

//${Shared::Sporadic2_ctor} ..................................................
void Sporadic2_ctor(void) {
    Sporadic2 * const me = &Sporadic2_inst;
    QMActive_ctor(&me->super, Q_STATE_CAST(&Sporadic2_initial));
}
//$enddef${Shared::Sporadic2_ctor} ^^^^^^^^^^^^^^^^^^^^^^^^^^^^^^^^^^^^^^^^^^^
//$define${Shared::AO_Sporadic2} vvvvvvvvvvvvvvvvvvvvvvvvvvvvvvvvvvvvvvvvvvvvv

//${Shared::AO_Sporadic2} ....................................................
QActive * const AO_Sporadic2 = (QActive *)&Sporadic2_inst;
//$enddef${Shared::AO_Sporadic2} ^^^^^^^^^^^^^^^^^^^^^^^^^^^^^^^^^^^^^^^^^^^^^
//$define${AOs::Sporadic2} vvvvvvvvvvvvvvvvvvvvvvvvvvvvvvvvvvvvvvvvvvvvvvvvvvv

//${AOs::Sporadic2} ..........................................................
Sporadic2 Sporadic2_inst;

//${AOs::Sporadic2::SM} ......................................................
static QState Sporadic2_initial(Sporadic2 * const me, void const * const par) {
    //${AOs::Sporadic2::SM::initial}
    Q_UNUSED_PAR(par);

    QS_FUN_DICTIONARY(&Sporadic2_active);

    static QMTranActTable const tatbl_ = { // tran-action table
        &Sporadic2_active_s, // target state
        {
            Q_ACTION_NULL // zero terminator
        }
    };
    return QM_TRAN_INIT(&tatbl_);
}

//${AOs::Sporadic2::SM::active} ..............................................
//${AOs::Sporadic2::SM::active}
static QState Sporadic2_active(Sporadic2 * const me, QEvt const * const e) {
    QState status_;
    switch (e->sig) {
        //${AOs::Sporadic2::SM::active::SPORADIC_A}
        case SPORADIC_A_SIG: {
            Q_UNUSED_PAR(me);

            BSP_d5on();
            QACTIVE_POST(AO_Sporadic3, e, me); // Sporadic2 --> Sporadic3
            BSP_d5off();
            status_ = QM_HANDLED();
            break;
        }
        //${AOs::Sporadic2::SM::active::SPORADIC_B}
        case SPORADIC_B_SIG: {
            BSP_d5on();
            QACTIVE_POST(AO_Periodic1, BSP_getEvtPeriodic1(1U), me);
            BSP_d5off();

            for (uint16_t i = Q_EVT_CAST(SporadicSpecEvt)->toggles;
                 i > 0U; --i)
            {
                BSP_d5on();
                BSP_d5off();
            }
            status_ = QM_HANDLED();
            break;
        }
        default: {
            status_ = QM_SUPER();
            break;
        }
    }
    return status_;
}
//$enddef${AOs::Sporadic2} ^^^^^^^^^^^^^^^^^^^^^^^^^^^^^^^^^^^^^^^^^^^^^^^^^^^
```
